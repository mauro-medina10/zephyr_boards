## pesaje_samd20e16/Kconfig.board
```kconfig
# SAM D20 Xplained Pro Board configuration

# Copyright (c) 2018 Sean Nyekjaer
# SPDX-License-Identifier: Apache-2.0

config BOARD_PESAJE_SAMD20E16
	bool "Pesaje SAM D20 E16"
	depends on SOC_PART_NUMBER_SAMD20E16
```

## pesaje_samd20e16/Kconfig.defconfig
```kconfig
# SAM D20 Xplained Pro board configuration

# Copyright (c) 2018 Sean Nyekjaer
# SPDX-License-Identifier: Apache-2.0

config BOARD
	default "atsamd20e16_pesaje"
	depends on BOARD_PESAJE_SAMD20E16
```

## pesaje_samd20e16/pesaje_samd20e16_defconfig
```kconfig
# SPDX-License-Identifier: Apache-2.0

#Device family
CONFIG_SOC_SERIES_SAMD20=y
CONFIG_SOC_PART_NUMBER_SAMD20E16=y
CONFIG_BOARD_ATSAMD20_XPRO=y
#Build
CONFIG_BUILD_OUTPUT_HEX=y
CONFIG_CORTEX_M_SYSTICK=y
#RTT console
CONFIG_LOG=y
CONFIG_CONSOLE=y
CONFIG_UART_CONSOLE=n
CONFIG_RTT_CONSOLE=y
CONFIG_USE_SEGGER_RTT=y
#Console & peripherals
CONFIG_SERIAL=y
CONFIG_UART_SAM0=y
CONFIG_UART_INTERRUPT_DRIVEN=y
CONFIG_GPIO=y
CONFIG_GPIO_SAM0=y
CONFIG_WATCHDOG=y
CONFIG_WDT_SAM0=y
CONFIG_SOC_ATMEL_SAMD_XOSC32K=y
CONFIG_SOC_ATMEL_SAMD_XOSC32K_AS_MAIN=y
```
